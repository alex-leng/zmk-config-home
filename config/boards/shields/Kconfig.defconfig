## config/boards/shields/Kconfig.defconfig
```kconfig
# Copyright (c) 2026 The ZMK Contributors
# SPDX-License-Identifier: MIT

if SHIELD_CORNE_LEFT || SHIELD_CORNE_RIGHT

config ZMK_KEYBOARD_NAME
    default "Corne"

# 1. Turn off split mode completely for solo testing
config ZMK_SPLIT
    default n

# 2. Force ZMK to prioritize USB typing over Bluetooth connection
config ZMK_USB
    default y

config ZMK_BLE
    default n

# 3. Prevent automatic output switching to Bluetooth
config ZMK_OUTPUT_BEHAVIOR_CURRENT
    default 1

# 4. Turn off LEDs to clear any hardware pin conflicts
config ZMK_RGB_UNDERGLOW
    default n

config WS2812_STRIP
    default n

endif
```
